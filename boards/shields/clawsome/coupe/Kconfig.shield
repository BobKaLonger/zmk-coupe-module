## boards/shields/clawsome/coupe/Kconfig.shield
```kconfig
# No whitespace after the comma or in your keyboard name!
config COUPE
    def_bool $(shields_list_contains,coupe)
```

## west.yml
```yaml
manifest:
  self:
    name: zmk-keyboard-coupe
    path: .
    revision: main
    west-version: '*'
```
